## boards/shields/cornebt/Kconfig.defconfig
```kconfig
if SHIELD_CORNEBT_LEFT

config ZMK_KEYBOARD_NAME
    default "CorneBt"

config ZMK_SPLIT_ROLE_CENTRAL
    default y

endif

if SHIELD_CORNEBT_LEFT || SHIELD_CORNEBT_RIGHT

config ZMK_SPLIT
    default y

endif
```

## boards/shields/cornebt/Kconfig.shield
```kconfig
config SHIELD_CORNEBT_LEFT
    def_bool $(shields_list_contains,cornebt_left)

config SHIELD_CORNEBT_RIGHT
    def_bool $(shields_list_contains,cornebt_right)
    
```

## config/Kconfig
```kconfig
config ZMK_LED_CONTROL
    bool "Enable automatic LED control based on activity"
    default y
    help
      Enable automatic control of external LEDs based on keyboard activity state.
      LEDs will turn off after idle timeout and turn back on when activity is detected.
```

## config/west.yml
```yaml
manifest:
  remotes:
    - name: zmkfirmware
      url-base: https://github.com/zmkfirmware
    - name: mctechnology17
      url-base: https://github.com/mctechnology17
    - name: Catalin2092
      url-base: https://github.com/Catalin2092
  projects:
    - name: zmk
      remote: zmkfirmware
      revision: v0.3.0
      import: app/west.yml
    - name: zmk-nice-oled
      remote: mctechnology17
      revision: main
    - name: zmk-dumb-led
      remote: Catalin2092
      revision: main
  self:
    path: config
```
